## ESP32_DRONE_REMOTE_ID_Firmware/components/esp_remote_id/Kconfig.projbuild
```kconfig
menu "ESP Remote ID Configuration"

    config RID_LED_R_GPIO
        int "RGB LED Red GPIO"
        default -1
        range -1 48
        help
            GPIO pin for the red channel of the status RGB LED.
            Set to -1 to disable.

    config RID_LED_G_GPIO
        int "RGB LED Green GPIO"
        default -1
        range -1 48
        help
            GPIO pin for the green channel of the status RGB LED.
            Set to -1 to disable.

    config RID_LED_B_GPIO
        int "RGB LED Blue GPIO"
        default -1
        range -1 48
        help
            GPIO pin for the blue channel of the status RGB LED.
            Set to -1 to disable.

endmenu
```

## ESP32_DRONE_REMOTE_ID_Firmware/sdkconfig.defaults
```kconfig
CONFIG_BT_ENABLED=y
CONFIG_ESP32_IGNORE_MAC_CRC_ERROR=y
CONFIG_ESP32S3_IGNORE_MAC_CRC_ERROR=y
CONFIG_ESP32C3_IGNORE_MAC_CRC_ERROR=y
CONFIG_MBEDTLS_SHA256_ENABLED=y
```
